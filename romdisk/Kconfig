## romdisk/Kconfig
```kconfig
menu "Zeal Shell (init.bin)"

        config INITBIN_ENABLE_COREUTILS
                bool
                prompt "Enable zeal-coreutils"
                default n
                help
                        Boolean to mark whether the user is including zeal-coreutils themselves.
                        If this option is selected, the "coreutils" commands will be ommited from
                        the init.bin shell (ie; ls, cp, mkdir, rm, etc)
endmenu
```
